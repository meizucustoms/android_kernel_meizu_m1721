## drivers/input/fingerprint/Kconfig
```kconfig
config INPUT_FINGERPRINT
	tristate "Fingerprint driver support"
	help
	  Say Y here to enable fingerprint driver support.

if MACH_MEIZU
source "drivers/input/fingerprint/goodix/Kconfig"
endif
```

## drivers/input/fingerprint/Kconfig.txt
```kconfig
config INPUT_FINGERPRINT
	tristate "Fingerprint driver support"
	help
	  Say Y here to enable fingerprint driver support!
	  
config FINGERPRINT_GOODIX
	tristate "Goodix fingerprint drvier support"
	depends on INPUT_FINGERPRINT
	help
	  Say Y here to enable Goodix fingerprint driver support!
```

## drivers/input/fingerprint/goodix/Kconfig
```kconfig
config FINGERPRINT_GOODIX
	tristate "Goodix fingerprint drvier support"
	depends on INPUT_FINGERPRINT
	help
	  Say Y here to enable Goodix fingerprint driver support! 
```

## drivers/platform/meizu/Kconfig
```kconfig
# Meizu configuration options
config MEIZU_HARDWARE_INFO
	bool "Camera info for Meizu M6 note"
	help
	  Enable kernel meizu_hw driver to get HW info
```

## sound/soc/meizu/spk_proinfo/Kconfig
```kconfig
config MEIZU_SPEAKER_PROINFO
	bool "TXJ Speaker Calibration"
	help
	  Enable kernel TXJ driver to support OS-level library for speaker
```
