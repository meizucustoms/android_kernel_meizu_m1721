
/*
 * Copyright (c) 2017, The Linux Foundation. All rights reserved.
 *
 * This program is free software; you can redistribute it and/or modify
 * it under the terms of the GNU General Public License version 2 and
 * only version 2 as published by the Free Software Foundation.
 *
 * This program is distributed in the hope that it will be useful,
 * but WITHOUT ANY WARRANTY; without even the implied warranty of
 * MERCHANTABILITY or FITNESS FOR A PARTICULAR PURPOSE.  See the
 * GNU General Public License for more details.
 */

&int_codec {
	status = "ok";
	qcom,msm-ext-pa = "quaternary";
	qcom,msm-mbhc-hphl-swh = <1>;
	qcom,msm-mbhc-gnd-swh = <1>;

	qcom,msm-gpios = 
		"pri_i2s", 
		"us_eu_gpio", 
		"quin_i2s", 
		"quat_i2s";

	pinctrl-names = 							// Total: 16
		"all_off",								// 0
		"pri_i2s_act", 							// 1
		"us_eu_gpio_act", 						// 2
		"pri_i2s_us_eu_gpio_act", 				// 3
		"quin_act", 							// 4
		"quin_pri_i2s_act", 					// 5
		"quin_us_eu_gpio_act", 					// 6
		"quin_us_eu_gpio_pri_i2s_act", 			// 7
		"quat_i2s_act", 						// 8
		"quat_pri_i2s_act", 					// 9
		"quat_us_eu_gpio_act", 					// 10
		"quat_pri_i2s_us_eu_gpio_act", 			// 11
		"quat_quin_act", 						// 12
		"quat_quin_pri_i2s_act", 				// 13
		"quat_quin_us_eu_gpio_act", 			// 14
		"quat_quin_us_eu_gpio_pri_i2s_act";		// 15

	/* Idk for what, Qualcomm duplicated pinctrl-names with their prefix ._. */
	
	qcom,pinctrl-names = 						// Total: 16
		"all_off",								// 0
		"pri_i2s_act", 							// 1
		"us_eu_gpio_act", 						// 2
		"pri_i2s_us_eu_gpio_act", 				// 3
		"quin_act", 							// 4
		"quin_pri_i2s_act", 					// 5
		"quin_us_eu_gpio_act", 					// 6
		"quin_us_eu_gpio_pri_i2s_act", 			// 7
		"quat_i2s_act", 						// 8
		"quat_pri_i2s_act", 					// 9
		"quat_us_eu_gpio_act", 					// 10
		"quat_pri_i2s_us_eu_gpio_act", 			// 11
		"quat_quin_act", 						// 12
		"quat_quin_pri_i2s_act", 				// 13
		"quat_quin_us_eu_gpio_act", 			// 14
		"quat_quin_us_eu_gpio_pri_i2s_act";		// 15

	pinctrl-0 = <&cdc_pdm_lines_sus &sec_tlmm_lines_sus
				 &cdc_pdm_lines_2_sus &cross_conn_det_sus 
				 &pri_tlmm_lines_sus &pri_tlmm_ws_sus 
				 &cs35l35_mclk_off>;

	pinctrl-1 = <&cdc_pdm_lines_act &sec_tlmm_lines_sus 
				 &cdc_pdm_lines_2_act &cross_conn_det_sus 
				 &pri_tlmm_lines_sus &pri_tlmm_ws_sus 
				 &cs35l35_mclk_off>;

	pinctrl-2 = <&cdc_pdm_lines_sus &sec_tlmm_lines_sus 
				 &cdc_pdm_lines_2_sus &cross_conn_det_act 
				 &pri_tlmm_lines_sus &pri_tlmm_ws_sus 
				 &cs35l35_mclk_off>;

	pinctrl-3 = <&cdc_pdm_lines_act &sec_tlmm_lines_sus
				 &cdc_pdm_lines_2_act &cross_conn_det_act
				 &pri_tlmm_lines_sus &pri_tlmm_ws_sus
				 &cs35l35_mclk_off>;

	pinctrl-4 = <&cdc_pdm_lines_sus &sec_tlmm_lines_sus
				 &cdc_pdm_lines_2_sus &cross_conn_det_sus 
				 &pri_tlmm_lines_act &pri_tlmm_ws_act 
				 &cs35l35_mclk_off>;

	pinctrl-5 = <&cdc_pdm_lines_act &sec_tlmm_lines_sus
				 &cdc_pdm_lines_2_act &cross_conn_det_sus 
				 &pri_tlmm_lines_act &pri_tlmm_ws_act 
				 &cs35l35_mclk_off>;

	pinctrl-6 = <&cdc_pdm_lines_sus &sec_tlmm_lines_sus
				 &cdc_pdm_lines_2_sus &cross_conn_det_act 
				 &pri_tlmm_lines_act &pri_tlmm_ws_act 
				 &cs35l35_mclk_off>;

	pinctrl-7 = <&cdc_pdm_lines_act &sec_tlmm_lines_sus
				 &cdc_pdm_lines_2_act &cross_conn_det_act 
				 &pri_tlmm_lines_act &pri_tlmm_ws_act 
				 &cs35l35_mclk_off>;

	pinctrl-8 = <&cdc_pdm_lines_sus &sec_tlmm_lines_act
				 &cdc_pdm_lines_2_sus &cross_conn_det_sus 
				 &pri_tlmm_lines_sus &pri_tlmm_ws_sus 
				 &cs35l35_mclk_on>;

	pinctrl-9 = <&cdc_pdm_lines_act &sec_tlmm_lines_act
				 &cdc_pdm_lines_2_act &cross_conn_det_sus 
				 &pri_tlmm_lines_sus &pri_tlmm_ws_sus 
				 &cs35l35_mclk_on>;

	pinctrl-10 = <&cdc_pdm_lines_sus &sec_tlmm_lines_act
				  &cdc_pdm_lines_2_sus &cross_conn_det_act 
				  &pri_tlmm_lines_sus &pri_tlmm_ws_sus 
				  &cs35l35_mclk_on>;

	pinctrl-11 = <&cdc_pdm_lines_act &sec_tlmm_lines_act
				  &cdc_pdm_lines_2_act &cross_conn_det_act 
				  &pri_tlmm_lines_sus &pri_tlmm_ws_sus 
				  &cs35l35_mclk_on>;

	pinctrl-12 = <&cdc_pdm_lines_sus &sec_tlmm_lines_act
				  &cdc_pdm_lines_2_sus &cross_conn_det_sus 
				  &pri_tlmm_lines_act &pri_tlmm_ws_act 
				  &cs35l35_mclk_on>;

	pinctrl-13 = <&cdc_pdm_lines_act &sec_tlmm_lines_act
	              &cdc_pdm_lines_2_act &cross_conn_det_sus 
				  &pri_tlmm_lines_act &pri_tlmm_ws_act 
				  &cs35l35_mclk_on>;

	pinctrl-14 = <&cdc_pdm_lines_sus &sec_tlmm_lines_act
				  &cdc_pdm_lines_2_sus &cross_conn_det_act 
				  &pri_tlmm_lines_act &pri_tlmm_ws_act 
				  &cs35l35_mclk_on>;

	pinctrl-15 = <&cdc_pdm_lines_act &sec_tlmm_lines_act
	              &cdc_pdm_lines_2_act &cross_conn_det_act 
				  &pri_tlmm_lines_act &pri_tlmm_ws_act 
				  &cs35l35_mclk_on>;

	/delete-property/asoc-wsa-codec-names;
	/delete-property/asoc-wsa-codec-prefixes;
};